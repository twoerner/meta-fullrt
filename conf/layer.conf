## conf/layer.conf
```bitbake
# We have a conf and classes directory, append to BBPATH
BBPATH .= ":${LAYERDIR}"

# We have a recipes directory containing .bb and .bbappend files, add to BBFILES
BBFILES += "${LAYERDIR}/meta*/recipes*/*/*.bb"
BBFILES += "${LAYERDIR}/meta*/recipes*/*/*.bbappend"

BBFILE_COLLECTIONS += "fullrt"
BBFILE_PATTERN_fullrt := "^${LAYERDIR}/"
BBFILE_PRIORITY_fullrt = "9"
BB_DANGLINGAPPENDS_WARNONLY ?= "1"
```
